## apps/KConfig
```kconfig
#
# Copyright (c) Qualcomm Technologies, Inc. and/or its subsidiaries.
# SPDX-License-Identifier: BSD-3-Clause-Clear
#

menu "tafMngdConnSvc"
rsource "tafMngdServices/Connectivity/tafMngdConnSvc.kconfig"
endmenu # end "tafMngdConnSvc"
```

## framework/daemons/linux/deviceManager/KConfig
```kconfig
#
# Copyright (c) 2023 Qualcomm Innovation Center, Inc. All rights reserved.
# SPDX-License-Identifier: BSD-3-Clause-Clear
#

config VHAL_DRIVER_DIR
  string "VHAL driver directory"
  default "/app/tmp/drivers/"
  ---help---
  Directory to store vendor-developed drivers, deviceManger will scan and install drivers from this.
```
